VERSION ""

NS_ :

BS_:

BU_: Node2 Node1

BO_ 2566852611 Node2Broadcast: 4 Node2
 SG_ UnsignedValue : 23|16@0+ (1,-32767) [-32767|32768] "" Vector__XXX
 SG_ SignedValue : 7|16@0- (1,0) [-32768|32767] "gear"  Node1

BO_ 2565800704 Node1ToNode2: 8 Node1
 SG_ NonMuxedData : 23|8@0+ (1,0) [0|255] ""  Node2
 SG_ NestedMultiplexor m0M : 15|8@0+ (1,0) [0|255] ""  Node2
 SG_ EnumeratedSignal m0 : 57|2@0+ (1,0) [0|3] ""  Node2
 SG_ PressureOverThreeBytes m1 : 40|11@0+ (0.0875,0) [0|179.1125] "PSI"  Node2
 SG_ IntelOdometer m2 : 32|32@1+ (1,0) [0|4294967295] "km"  Node2
 SG_ MultiplexorSignal M : 7|8@0+ (1,0) [0|0] ""  Node2

BA_DEF_ SG_  "SigType" ENUM  "Default","Range","RangeSigned","ASCII","Discrete","Control","ReferencePGN","DTC","StringDelimiter","StringLength","StringLengthControl","MessageCounter","MessageChecksum";
BA_DEF_ SG_  "GenSigEVName" STRING ;
BA_DEF_ SG_  "GenSigILSupport" ENUM  "No","Yes";
BA_DEF_ SG_  "GenSigSendType" ENUM  "Cyclic","OnWrite","OnWriteWithRepetition","OnChange","OnChangeWithRepetition","IfActive","IfActiveWithRepetition","NoSigSendType";
BA_DEF_ SG_  "GenSigStartValue" INT 0 2147483647;
BA_DEF_ BO_  "GenMsgILSupport" ENUM  "No","Yes";
BA_DEF_ BU_  "NmStationAddress" INT 0 255;
BA_DEF_ BO_  "GenMsgSendType" ENUM  "cyclic","NotUsed","IfActive","NotUsed","NotUsed","NotUsed","NotUsed","NotUsed","noMsgSendType";
BA_DEF_ BO_  "GenMsgRequestable" INT 0 1;
BA_DEF_  "DBName" STRING ;
BA_DEF_  "BusType" STRING ;
BA_DEF_  "ProtocolType" STRING ;
BA_DEF_ BO_  "VFrameFormat" ENUM  "StandardCAN","ExtendedCAN","reserved","J1939PG";
BA_DEF_DEF_  "SigType" "Default";
BA_DEF_DEF_  "GenSigEVName" "Env@Nodename_@Signame";
BA_DEF_DEF_  "GenSigILSupport" "Yes";
BA_DEF_DEF_  "GenSigSendType" "NoSigSendType";
BA_DEF_DEF_  "GenSigStartValue" 0;
BA_DEF_DEF_  "GenMsgILSupport" "Yes";
BA_DEF_DEF_  "NmStationAddress" 254;
BA_DEF_DEF_  "GenMsgSendType" "noMsgSendType";
BA_DEF_DEF_  "GenMsgRequestable" 1;
BA_DEF_DEF_  "DBName" "";
BA_DEF_DEF_  "BusType" "CAN";
BA_DEF_DEF_  "ProtocolType" "J1939";
BA_DEF_DEF_  "VFrameFormat" "J1939PG";
BA_ "DBName" "ExampleDBC";
BA_ "NmStationAddress" BU_ Node2 3;
BA_ "NmStationAddress" BU_ Node1 0;
BA_ "GenSigStartValue" SG_ 2566852611 UnsignedValue 32767;
VAL_ 2565800704 NestedMultiplexor 1 "Variant 2" 0 "Variant 1" ;
VAL_ 2565800704 EnumeratedSignal 3 "Not Available" 2 "Not Used" 1 "On" 0 "Off" ;
VAL_ 2565800704 MultiplexorSignal 2 "Data Group 3" 1 "Data Group 2" 0 "Data Group 1" ;

SG_MUL_VAL_ 2565800704 NestedMultiplexor MultiplexorSignal 0-0;
SG_MUL_VAL_ 2565800704 EnumeratedSignal NestedMultiplexor 0-0;
SG_MUL_VAL_ 2565800704 PressureOverThreeBytes MultiplexorSignal 1-1;
SG_MUL_VAL_ 2565800704 IntelOdometer MultiplexorSignal 2-2;
